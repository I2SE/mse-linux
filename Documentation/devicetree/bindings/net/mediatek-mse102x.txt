## Documentation/devicetree/bindings/net/mediatek-mse102x.txt
```
* Mediatek MSE102x (SPI)

The Mediatek MSE102x is a family of Homeplug GreenPHY chips. They can be
connected either via RGMII, RMII or SPI to a host CPU.

In order to use the MSE102x as SPI device it must be defined as a child of a
SPI master in the device tree.

Required properties:
- compatible	    : Should be "mediatek,mse1021" or "mediatek,mse1022"
- reg		    : Should specify the SPI chip select
- interrupts	    : The first cell should specify the index of the source
		      interrupt and the second cell should specify the trigger
		      type as rising edge
- spi-cpha	    : Must be set
- spi-cpol	    : Must be set

Optional properties:
- spi-max-frequency : Maximum frequency of the SPI bus the chip can operate at.
		      Numbers smaller than 1000000 or greater than 7000000
		      are invalid. Missing the property will set the SPI
		      frequency to 6000000 Hertz.

The MAC address will be determined using the optional properties
defined in ethernet.txt.

Example:

@spi0 {
	#address-cells = <1>;
	#size-cells = <0>;

	mse1021: ethernet@0 {
		compatible = "mediatek,mse1021";
		reg = <0>;
		interrupt-parent = <&gpio>;
		interrupts = <23 0x1>;		/* rising edge */
		spi-cpha;			/* SPI mode: CPHA=1 */
		spi-cpol;			/* SPI mode: CPOL=1 */
		spi-max-frequency = <7000000>;
		local-mac-address = [ A0 B0 C0 D0 E0 F0 ];
	};
};
```

## Documentation/devicetree/bindings/net/vertexcom-mse102x.txt
```
* Vertexcom MSE102x (SPI)

Vertexcom's MSE102x are a family is HomePlug GreenPHY chips.
They can be connected either via RGMII, RMII or SPI to a host CPU.

In order to use a MSE102x chip as SPI device, it must be defined as
a child of an SPI master device in the device tree.

Required properties:
- compatible	    : Should be "vertexcom,mse1021" or "vertexcom,mse1022"
- reg		    : Should specify the SPI chip select
- interrupts	    : The first cell should specify the index of the source
		      interrupt and the second cell should specify the trigger
		      type as rising edge
- spi-cpha	    : Must be set
- spi-cpol	    : Must be set

Optional properties:
- spi-max-frequency : Maximum frequency of the SPI bus when accessing the chip.
		      Must be in the range 6000000 to 7142857 (in Hertz).
		      If this property is missing, the driver will use the
		      above mentioned maximum value.
- local-mac-address : See ethernet.txt in the same directory.

Example:

@spi0 {
	#address-cells = <1>;
	#size-cells = <0>;

	mse1021: ethernet@0 {
		compatible = "vertexcom,mse1021";
		reg = <0>;
		interrupt-parent = <&gpio>;
		interrupts = <23 0x1>;		/* rising edge */
		spi-cpha;			/* SPI mode: CPHA=1 */
		spi-cpol;			/* SPI mode: CPOL=1 */
		spi-max-frequency = <7142857>;
		local-mac-address = [ A0 B0 C0 D0 E0 F0 ];
	};
};
```

## drivers/net/ethernet/mediatek/Kconfig
```kconfig
# SPDX-License-Identifier: GPL-2.0-only
config NET_VENDOR_MEDIATEK
	bool "MediaTek devices"
	help
	  If you have a Mediatek SoC with ethernet, say Y.

if NET_VENDOR_MEDIATEK

config NET_MEDIATEK_SOC
	tristate "MediaTek SoC Gigabit Ethernet support"
	depends on ARCH_MEDIATEK || SOC_MT7621 || SOC_MT7620
	select PHYLINK
	help
	  This driver supports the gigabit ethernet MACs in the
	  MediaTek SoC family.

config NET_MEDIATEK_STAR_EMAC
	tristate "MediaTek STAR Ethernet MAC support"
	depends on ARCH_MEDIATEK || SOC_MT7621 || SOC_MT7620
	select PHYLIB
	select REGMAP_MMIO
	help
	  This driver supports the ethernet MAC IP first used on
	  MediaTek MT85** SoCs.

endif #NET_VENDOR_MEDIATEK
```

## drivers/net/ethernet/mediatek/mse102x/Kconfig
```kconfig
# SPDX-License-Identifier: GPL-2.0-only
#

config MSE102X
	tristate "Mediatek MSE102x SPI"
	depends on SPI
	help
	  SPI driver for Mediatek MSE102x SPI attached network chip.
```
